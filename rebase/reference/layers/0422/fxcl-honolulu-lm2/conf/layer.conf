## rebase/reference/layers/0422/fxcl-honolulu-lm2/conf/layer.conf
```bitbake
#
# Copyright (C) 2013 Wind River Systems, Inc.
#
BBPATH ?= ""
# We have a conf and classes directory, add to BBPATH
BBPATH := "${LAYERDIR}:${BBPATH}"

# We have a packages directory, add to BBFILES
BBFILES := "${BBFILES} ${LAYERDIR}/recipes-*/*/*.bb \
	${LAYERDIR}/recipes-*/*/*.bbappend \
	${LAYERDIR}/classes/*.bbclass"

BBFILE_COLLECTIONS += "fxcl-honolulu-lm2"
BBFILE_PATTERN_fxcl-honolulu-lm2 := "^${LAYERDIR}/"
BBFILE_PRIORITY_fxcl-honolulu-lm2 = "7"

include conf/wr.conf

# We have a pre-populated downloads directory, add to PREMIRRORS
PREMIRRORS_append := " \
	git://.*/.* file://${LAYERDIR}/downloads/ \n \
	svn://.*/.* file://${LAYERDIR}/downloads/ \n \
	ftp://.*/.* file://${LAYERDIR}/downloads/ \n \
	http://.*/.* file://${LAYERDIR}/downloads/ \n \
	https://.*/.* file://${LAYERDIR}/downloads/ \n"
```

## rebase/reference/layers/fxcl-waikiki-lm2/conf/machine/tune-cortexa15.inc
```bitbake
#
# Copyright (C) 2013 Wind River Systems, Inc.
#
# Refer to tune-cortexa15.inc of yocto's meta-ti and tune-cortexa9.inc of windriver
DEFAULTTUNE ?= "cortexa15t-neon"

# WR-specific:  This file radically changes the CCARGS values.
require conf/machine/include/tune-armv7at.inc

TUNEVALID[cortexa15] = "Enable Cortex-A15 specific processor optimizations"

TUNEABI_CCARGS_tune_cortexa15t-nvfp = "${TUNEABI_CCARGS_tune_armv7at-nvfp}"
TUNEABI_CCARGS_tune_cortexa15t = "${TUNEABI_CCARGS_tune_armv7at}"
TUNEABI_CCARGS_tune_cortexa15t-neon = "${TUNEABI_CCARGS_tune_armv7at-neon}"

TUNE_CCARGS += "${@bb.utils.contains("TUNE_FEATURES", "cortexa15", "-mtune=cortex-a15", "", d)}"

# Little Endian base configs
AVAILTUNES += "cortexa15t-nvfp cortexa15 cortexa15t cortexa15t-neon"
TUNE_FEATURES_tune-cortexa15t-nvfp = "${TUNE_FEATURES_tune-armv7at-nvfp} cortexa15"
TUNE_FEATURES_tune-cortexa15 = "${TUNE_FEATURES_tune-armv7a} cortexa15"
TUNE_FEATURES_tune-cortexa15t ?= "${TUNE_FEATURES_tune-armv7at} cortexa15"
TUNE_FEATURES_tune-cortexa15t-neon ?= "${TUNE_FEATURES_tune-armv7at-neon} cortexa15"

TUNEABI_tune-cortexa15t-nvfp = "armv7at-nvfp"
TUNEABI_tune-cortexa15t ?= "armv7at"
TUNEABI_tune-cortexa15 ?= "armv7a"
TUNEABI_tune-cortexa15t-neon ?= "armv7at-neon"

PACKAGE_EXTRA_ARCHS_tune-cortexa15t-nvfp = "${PACKAGE_EXTRA_ARCHS_tune-armv7at-nvfp}"
PACKAGE_EXTRA_ARCHS_tune-cortexa15 = "${PACKAGE_EXTRA_ARCHS_tune-armv7a}"
PACKAGE_EXTRA_ARCHS_tune-cortexa15t = "${PACKAGE_EXTRA_ARCHS_tune-armv7at}"
PACKAGE_EXTRA_ARCHS_tune-cortexa15t-neon = "${PACKAGE_EXTRA_ARCHS_tune-armv7at-neon}"

# VFP Tunes
AVAILTUNES += "cortexa15hf cortexa15thf cortexa15hf-neon"
TUNE_FEATURES_tune-cortexa15hf ?= "${TUNE_FEATURES_tune-armv7ahf} cortexa15"
TUNE_FEATURES_tune-cortexa15thf ?= "${TUNE_FEATURES_tune-armv7athf} cortexa15"
TUNE_FEATURES_tune-cortexa15hf-neon ?= "${TUNE_FEATURES_tune-armv7ahf-neon} cortexa15"

TUNEABI_tune-cortexa15hf = "armv7ahf"
TUNEABI_tune-cortexa15thf ?= "armv7athf"
TUNEABI_tune-cortexa15hf-neon ?= "armv7ahf-neon"

PACKAGE_EXTRA_ARCHS_tune-cortexa15hf = "${PACKAGE_EXTRA_ARCHS_tune-armv7ahf}"
PACKAGE_EXTRA_ARCHS_tune-cortexa15thf = "${PACKAGE_EXTRA_ARCHS_tune-armv7athf}"
PACKAGE_EXTRA_ARCHS_tune-cortexa15hf-neon = "${PACKAGE_EXTRA_ARCHS_tune-armv7ahf-neon}"
```

## rebase/reference/src/rcpl12linux/linux/arch/arm/mach-iproc/Kconfig
```kconfig
menu	"iProc SoC based Machine types"
	depends on MACH_IPROC

choice
	prompt "iProc SoC based board type"
	default MACH_IPROC_NS	

config MACH_NS
	bool "Support Broadcom Northstar bring-up board"
	help
	  Support for the Broadcom Northstar bring-up board.

config MACH_HX4
	bool "Support Broadcom Helix4 bring-up board"
	help
	  Support for the Broadcom Helix4 bring-up board.

config MACH_HR2
	bool "Support Broadcom Hurricane2 bring-up board"
	help
	  Support for the Broadcom Hurricane2 bring-up board.

config MACH_NSP
	bool "Support Broadcom Northstar Plus bring-up board"
	help
	  Support for the Broadcom Northstar Plus bring-up board.

config MACH_KT2
	bool "Support Broadcom Katana2 bring-up board"
	help
	  Support for the Broadcom Katana2 bring-up board.

endchoice

config MACH_IPROC_EMULATION
	bool "Support  iProc emulation"
	help
	  Support for the iProc emulation.

config IPROC_PMU
	tristate "Iproc PMU support"
	depends on ARCH_IPROC
	default y
	help
	  Iproc PMU support 
	  This config provides kernel-side support for iProc PMU description.
	  Its generic driver is perf_event.c
endmenu
```

## rebase/reference/src/rcpl12linux/linux/arch/arm/mach-keystone/Kconfig
```kconfig
if ARCH_KEYSTONE

config TI_KEYSTONE
	bool

menu "TI KeyStone Implementations"

config KEYSTONE2_DMA_COHERENT
	bool "MPAX based coherency support"
	default n

endmenu

endif
```

## rebase/reference/src/rcpl12linux/linux/drivers/net/ethernet/broadcom/gmac/otp/Kconfig
```kconfig
config IPROC_OTP
	tristate "OTP support"
	depends on ARCH_IPROC
	default n
	help
	  OTP support 
	
	  If unsure, say N.
```

## rebase/reference/src/rcpl12linux_preempt/linux/drivers/clk/davinci/Kconfig
```kconfig
menu "TI DaVinci Clock Drivers"
	depends on COMMON_CLK

config  CLK_DAVINCI_PSC
	bool "TI DaVici PSC Clock driver"
	default n
	---help---
	  Selects clock driver for DaVinci PSC clocks. This clock
	  hardware is found on TI DaVinci SoCs and other SoCs that
	  uses this hardware IP. This hardware has a local power
	  sleep control module that gate the clock to the IP.

config  CLK_DAVINCI_PLL
	bool "DaVici Main PLL clock"
	---help---
	  Selects clock driver for DaVinci Main PLL. This clock
	  hardware is found on TI DaVinci SoCs. This typically has
	  a multiplier, a pre divider and post driver. Some of the
	  SoCs has the the dividers fixed, and others have it
	  programmable

config DAVINCI_CLKS
	bool "TI DaVinci common clocks"
	default n
	select CLK_DAVINCI_PSC
	select DAVINCI_CLKINIT
	---help---
	  Selects common clock drivers for DaVinci. These clocks
	  are re-used across many TI SoCs that are based on DaVinci and
	  Keystone (c6x) families. This config option is used to select
	  the common clock driver for DaVinci based SoCs. SoCs specific
	  Kconfig option needs to select the driver for clocks specific
	  to the SoC.

config	DAVINCI_CLKINIT
	bool "TI DaVici Clock initialization"
	default n
	---help---
	  Selects clock driver initialization for DaVinci and Keystone
	  architectures.
endmenu
```

## rebase/reference/src/rcpl12linux_preempt/linux/drivers/clk/keystone/Kconfig
```kconfig
config  CLK_KEYSTONE_PLL
	bool "Keystone Main PLL clock"
	---help---
	  Selects the clock driver for Keystone Main PLL. This clock
	  hardware is found on TI c6x based SoCs
```

## rebase/reference/src/rcpl27linux/linux/Documentation/devicetree/bindings/dma/keystone-pktdma.txt
```
This document explains the device tree bindings for the packet dma
on keystone devices. The Queue Manager Subsystem, The Packet Accelerator
Subsystem and the SRIO on Keystone Devices all have their own packet dma
modules. Each individual packet dma has a certain number of RX channels,
RX flows and TX channels. Each instance of the packet DMA is being
initialized through device specific bindings.

Explantions of the various options:

reg:	    the various registers offsets and the actual size from the offset
loop-back:  this is used only with the queue manger packet dma. This can be
	    used with other packet dma modules as well for testing purposes.
big-endian: keystone devices can be operated in a mode where the DSP is in the
            big endian mode. In such cases enable this option
enable-all: enables all RX and TX channels associated with an instance of the
            packet dma.
debug:      used to enable debug.To see debug messages the
            CONFIG_DMADEVICES_DEBUG must also be enabled in the .config
rx-priority: used to set the packet dma global rx priority.
tx-priority: used to set the packet dma global tx priority.

The channels that will be used then need to be initialized. Both RX and TX
channels need to be given bindings.

label:           This is used by the dma_request_channel_by_name APi to acquire
                 channels
pool:	         is the pool from where descriptors will be acquired. This pool
                 needs to be defined in the hardware queue layer.
decriptors:      the number of descriptors accociated with the channel. Care should
                 be taken that the total number of descriptors associated with a
	         pool is less than or equal to the number in the hardware queue
	         layer.
submit-queue:    The submit queue which will be used by the hardware queue layer.
completion-queue:the completion queue associated with a channel.
debug:           debug can be enabled on a per channel basis.
channel:	 the actual channel number to be used.
priority:	 the priority associated with a channel.
flow:		 the RX flow that will be used. Applicable only for
                 RX.
logical-queue-managers: number of logical queue managers
queues-per-queue-manager: the number of queues per queue manager
qm-base-address: the actual VBUSM address that needs to be programmed into
		 each QM_BASE_ADDR register. The number of distinct values
		 should be equal to the number of logical queue managers.

An examples is provided below. padma is packet dma instance associated
with the packet accelerator susbsystem.

		padma: pktdma@2004000 {
			compatible = "ti,keystone-pktdma";
			reg = <0x2004000 0x100		/* 0 - global  */
			       0x2004400 0x120		/* 1 - txchan  */
			       0x2004800 0x300		/* 2 - rxchan  */
			       0x2004c00 0x120		/* 3 - txsched */
			       0x2005000 0x400>;	/* 4 - rxflow  */
			/* loop-back;  */
			/* bigendian; */
			enable-all;
			/* debug; */

			logical-queue-managers	= <2>;
			queues-per-queue-manager = <4096>;
			qm-base-address = <0x34020000 0x34030000>;

			channels {
				nettx {
					transmit;
					label		= "nettx";
					pool		= "pool-net";
					descriptors	= <128>;
					submit-queue	= <648>;
					/* complete-queue = <xx>; */
					/* debug; */
					/* channel = <0>; */
					/* priority = <1>; */
				};
				netrx {
					receive;
					label		= "netrx";
					pool		= "pool-net";
					descriptors	= <128>;
					/* submit-queue   = <xx>; */
					complete-queue = <657>;
					/* debug; */
					/* channel = <0>; */
					flow		= <0>;
				};
				patx {
					transmit;
					label		= "patx";
					pool		= "pool-net";
					descriptors	= <8>;
					submit-queue	= <640>;
					/* complete-queue = <xx>; */
					/* debug; */
					/* channel = <xx>; */
					/* priority = <1>; */
					queues		= <640 4013>;
				};
				parx {
					receive;
					label		= "parx";
					pool		= "pool-net";
					descriptors	= <4>;
					/* submit-queue   = <xx>; */
					/* complete-queue = <xx>; */
					/* debug; */
					/* channel = <0>; */
					flow		= <1>;
				};
			};
		};
```

## rebase/reference/src/rcpl27linux/linux/drivers/net/ethernet/broadcom/gmac/et/Kconfig
```kconfig
config IPROC_GMAC
	tristate "GMAC support "
	select HND
	select ET
	select ET_47XX
	select ET_ALL_PASSIVE_ON
	select ET_NAPI2_POLL
	depends on ARCH_IPROC
	default n
	help
	  Add GMAC  support
	
	  If unsure, say N.
```

## rebase/reference/src/rcpl27linux_preempt/linux/arch/arm/plat-iproc/Kconfig
```kconfig
# Kernel configuration for Broadcom iProc based boards

menu	"Broadcom IPROC architecture based implementations"
	depends on ARCH_IPROC
	
choice
	prompt "Broadcom iProc SoC Type"
	default ARCH_NORTHSTAR	

config ARCH_NORTHSTAR
	bool "BROADCOM Northstar SoC"
	help
	  Support for the Broadcom Northstar SoC platform.

config MACH_IPROC
	bool "BROADCOM Generic IPROC SoC"
	help
	  Support for the Broadcom IPROC SoC platform.

endchoice


config IPROC_TIMER_UNIT_TESTS
	bool "Include iProc Timer unit test code"
	help
	  Say Y if you want to test the AON,Peripheral Timer modules using the sysfs interface

config IPROC_SW_RESET_RECORD
	bool "Include Software Reset Records"
	help
	  Say Y if you want to enable interface to access Software Reset Record.
	  Software Reset Record is a set of variables whose value could be retained
	  after reset (but will be cleared if powered off).

config DMAC_PL330
	bool "PL330 DMAC driver support for Kona architecture"
	depends on ARCH_RHEA
	select PL330
	help
	 Support for PL330 DMA Controller driver for Rhea SOC/KONA architecture

config BCM_ZRELADDR
	hex "Compressed ZREL address"

config BCM_PARAMS_PHYS
	hex "Address where tagged parameters are to be found"

config BCM_RAM_BASE
	hex "RAM base address"
	help
	 Set the physical base address of RAM

config IPROC_PCIE
	tristate "PCIE support"
	select PCI
	select PCI_DOMAINS
	depends on ARCH_IPROC
	default n
	help
	  Add PCIe support
	
	  If unsure, say N.

endmenu
```

## rebase/reference/src/rcpl27linux_standard/linux/drivers/net/ethernet/broadcom/gmac/mdio/Kconfig
```kconfig
config IPROC_MDIO
	tristate "MDIO support"
	depends on ARCH_IPROC
	default n
	help
	  MDIO support 
	
	  If unsure, say N.
```

## rebase/staging/output/layers/6/fxcl-honolulu-lm2/conf/machine/fxcl-honolulu-lm2.conf
```bitbake
#@TYPE: Machine
#@NAME: coretile-express-a15-a7
#@DESCRIPTION: coretile-express-a15-a7
#require tune-cortexa15.inc

DEFAULTTUNE = "armv7at-vfpv3"
require conf/machine/include/tune-cortexa9.inc

MACHINE_FEATURES = "usbhost jffs2 ext2"

KERNEL_IMAGETYPE = "zImage"

SERIAL_CONSOLE = "38400 ttyAMA0"
```
